## Documentation/devicetree/bindings/mfd/lm3631.txt
```
TI LM3631 MFD Driver

Required properties:
  - compatible: "ti,lm3631"
  - reg: I2C slave address. 0x29.
  - ti,en-gpio: GPIO number of LM3631 nRST pin.

LM3631 consists of two sub-devices, lm3631-regulator and lm3631-bl.

For the LM3631 regulator properties please refer to:
Documentation/devicetree/bindings/regulator/lm3631-regulator.txt

For the LM3631 backlight properties please refer to:
Documentation/devicetree/bindings/video/backlight/lm3631_bl.txt

Example:

lm3631@29 {
	compatible = "ti,lm3631";
	reg = <0x29>;

	/* GPIO134 for HWEN pin */
	ti,en-gpio = <&gpio5 6 0>;

	/* Only Vpos and Vneg are used with LCD boost */
	regulators {
		compatible = "ti,lm3631-regulator";

		vboost {
			regulator-name = "lcd_boost";
			regulator-min-microvolt = <4500000>;
			regulator-max-microvolt = <6350000>;
			regulator-always-on;
		};

		vpos {
			regulator-name = "lcd_vpos";
			regulator-min-microvolt = <4000000>;
			regulator-max-microvolt = <6000000>;
			regulator-boot-on;
		};

		vneg {
			regulator-name = "lcd_vneg";
			regulator-min-microvolt = <4000000>;
			regulator-max-microvolt = <6000000>;
			regulator-boot-on;
		};
	};

	/* Backlight mode is I2C + PWM, two strings used */
	backlight {
		compatible = "ti,lm3631-backlight";

		bl-name = "lcd";
		full-strings-used;
		mode-comb1;
	};
};
```

## Documentation/devicetree/bindings/mfd/lm3632.txt
```
TI LM3632 MFD Driver

Required properties:
  - compatible: "ti,lm3632"
  - reg: I2C slave address. 0x11.
  - ti,en-gpio: GPIO number of LM3632 EN pin.

LM3632 consists of lm3632-regulator and lm3632-bl.

For the LM3632 regulator properties please refer to:
Documentation/devicetree/bindings/regulator/lm3632-regulator.txt

For the LM3632 backlight properties please refer to:
Documentation/devicetree/bindings/video/backlight/lm3632_bl.txt

Example:

lm3632@11 {
	compatible = "ti,lm3632";
	reg = <0x11>;

	/* GPIO for EN pin */
	ti,en-gpio = <&gpio0 3 0>;

	/* Vpos and Vneg are used with LCD boost */
	regulators {
		compatible = "ti,lm3632-regulator";

		/* GPIOs for LCM_EN1 and LCM_EN2 pins */
		ti,lcm-en1-gpio = <&gpio0 2 0>;
		ti,lcm-en2-gpio = <&gpio0 4 0>;

		vboost {
			regulator-name = "lcd_boost";
			regulator-min-microvolt = <4500000>;
			regulator-max-microvolt = <6400000>;
			regulator-always-on;
		};

		vpos {
			regulator-name = "lcd_vpos";
			regulator-min-microvolt = <4000000>;
			regulator-max-microvolt = <6000000>;
			regulator-boot-on;
		};

		vneg {
			regulator-name = "lcd_vneg";
			regulator-min-microvolt = <4000000>;
			regulator-max-microvolt = <6000000>;
			regulator-boot-on;
		};
	};

	/* Backlight mode is PWM, two strings used */
	backlight {
		compatible = "ti,lm3632-backlight";

		bl-name = "lcd";
		full-strings-used;

		pwm-period = <10000>;
		pwm-max-brightness = <1637>; /* 20mA */

		/* PWM controller for lm3632 backlight */
		pwms = <&pwm3943 0 10000>;
		pwm-names = "lm3632-backlight";
	};
};
```

## Documentation/devicetree/bindings/regulator/lm3631-regulator.txt
```
TI LM3631 Regulator Driver

Required properties:
  - compatible: "ti,lm3631-regulator"
  - Regulator init data from of-regulator structure.
    Please refer to regulator.txt in this directory.

Example:

&i2c4 {
	clock-frequency = <400000>;

	lm3631@29 {
		compatible = "ti,lm3631";
		reg = <0x29>;

		/* GPIO134 for HWEN pin */
		ti,en-gpio = <&gpio5 6 0>;

		regulators {
			compatible = "ti,lm3631-regulator";

			vboost {
				regulator-name = "lcd_boost";
				regulator-min-microvolt = <4500000>;
				regulator-max-microvolt = <6350000>;
				regulator-always-on;
			};

			vcont {
				regulator-name = "lcd_cont";
				regulator-min-microvolt = <1800000>;
				regulator-max-microvolt = <3300000>;
			};

			voref {
				regulator-compatible = "voref";
				regulator-name = "lcd_oref";
				regulator-min-microvolt = <4000000>;
				regulator-max-microvolt = <6000000>;
			};

			vpos {
				regulator-name = "lcd_vpos";
				regulator-min-microvolt = <4000000>;
				regulator-max-microvolt = <6000000>;
				regulator-boot-on;
			};

			vneg {
				regulator-name = "lcd_vneg";
				regulator-min-microvolt = <4000000>;
				regulator-max-microvolt = <6000000>;
				regulator-boot-on;
			};
		};
};
```

## Documentation/devicetree/bindings/regulator/lm3632-regulator.txt
```
TI LM3632 Regulator Driver

Required properties:
  - compatible: "ti,lm3632-regulator"
  - Regulator init data from of-regulator structure.
    Please refer to regulator.txt in this directory.

Optional properties:
  Two GPIO pins are used for enabling/disabling VPOS and VNEG.
  These properties can be ignored if two LDOs are controlled through the I2C register.
  - ti,lcm-en1-gpio: GPIO number of LCM_EN1 pin.
  - ti,lcm-en2-gpio: GPIO number of LCM_EN2 pin.

Example:

lm3632@11 {
	compatible = "ti,lm3632";
	reg = <0x11>;

	ti,en-gpio = <&gpio0 3 0>;

	/* Vpos and Vneg are used with LCD boost */
	regulators {
		compatible = "ti,lm3632-regulator";

		/* GPIOs for LCM_EN1 and LCM_EN2 pins */
		ti,lcm-en1-gpio = <&gpio0 2 0>;
		ti,lcm-en2-gpio = <&gpio0 4 0>;

		vboost {
			regulator-name = "lcd_boost";
			regulator-min-microvolt = <4500000>;
			regulator-max-microvolt = <6400000>;
			regulator-always-on;
		};

		vpos {
			regulator-name = "lcd_vpos";
			regulator-min-microvolt = <4000000>;
			regulator-max-microvolt = <6000000>;
			regulator-boot-on;
		};

		vneg {
			regulator-name = "lcd_vneg";
			regulator-min-microvolt = <4000000>;
			regulator-max-microvolt = <6000000>;
			regulator-boot-on;
		};
	};
};
```

## Documentation/devicetree/bindings/regulator/lp8758.txt
```
TI LP8758 Regulator Driver

Required properties:
  - compatible: "ti,lp8758"
  - Regulator init data from of-regulator structure.
    Please refer to regulator.txt in this directory.

Example:
	lp8758@60 {
		compatible = "ti,lp8758";
		reg = <0x60>;

		/* 
		 * sub version info 
		 * 0 : b0
		 * 1 : d0
		 * 2 : e0
		 * 3 : f0
		 */
		sub_version = <3>;

		/* 
		 *  Buck Control Setting 
		 *     buck_ctrl[0] = buck0 control setting
		 *     buck_ctrl[1] = buck1 control setting
		 *     buck_ctrl[2] = buck2 control setting
		 *     buck_ctrl[3] = buck3 control setting
		 *  setting values
		 *     0: i2c control,
		 *     1: EN1 Pin Enable/Disable control,
		 *     2: EN1 Pin Roof/Floor     control,
		 *     3: EN2 Pin Enable/Disable control,
		 *     4: EN2 Pin Roof/Floor     control
		 */
		buck_ctrl = <1 0 1 0>;

		/*
		 * The gpio for interrupt depends on the processor environment.
		 * For example, following GPIO means GPIO60 in OMAP335x.
		 */
		irq-gpio = <&gpio1 28 0>;

		buck0 {
			regulator-name = "lp8758-buck0";
			regulator-min-microvolt = <500000>;
			regulator-max-microvolt = <3360000>;
			regulator-min-microamp  = <1500000>;
			regulator-max-microamp  = <5000000>;
			regulator-boot-on;
		};
		buck1 {
			regulator-name = "lp8758-buck1";
			regulator-min-microamp  = <1500000>;
			regulator-max-microamp  = <5000000>;
		};
		buck2 {
			regulator-name = "lp8758-buck2";
			regulator-min-microvolt = <500000>;
			regulator-max-microvolt = <3360000>;
			regulator-min-microamp  = <1500000>;
			regulator-max-microamp  = <5000000>;
			regulator-boot-on;
		};
		buck3 {
			regulator-name = "lp8758-buck3";
			regulator-min-microamp  = <1500000>;
			regulator-max-microamp  = <5000000>;
		};
	};
```

## Documentation/devicetree/bindings/video/backlight/lm3631_bl.txt
```
TI LM3631 Backlight Driver

Required properties:
  - compatible: "ti,lm3631-backlight"

Optional properties:
  - bl-name: Backlight device name
  - full-strings-used: Define it in case of two LED strings used.
  - mode-pwm-only: PWM input mode
    or mode-comb1: I2C x PWM befoer sloping
    or mode-comb2: Sloped I2C x PWM
    The default mode is the I2C only.
  - initial-brightness: Initial brightness value

PWM specific optional properties:
  - pwm-period: PWM period value. Define it in case of PWM based control mode.
  - pwms and pwm-names: Please refer to Documentation/devicetree/bindings/pwm/pwm.txt.


Example 1:
Brightness is I2C only mode. Backlight device name is 'lcd'.

&i2c4 {
	clock-frequency = <400000>;

	lm3631@29 {
		compatible = "ti,lm3631";
		reg = <0x29>;

		/* GPIO134 for HWEN pin */
		ti,en-gpio = <&gpio5 6 0>;

		backlight {
			compatible = "ti,lm3631-backlight";
			bl-name = "lcd";
			full-strings-used;
		};
};

Example 2:
LM3631 brightness is controlled by PWM3943 controller.
PWM3943 is a PWM controller. PWM#1 is port number of PMW3943.

&i2c4 {
	clock-frequency = <400000>;

	lm3631@29 {
		compatible = "ti,lm3631";
		reg = <0x29>;

		/* GPIO134 for HWEN pin */
		ti,en-gpio = <&gpio5 6 0>;

		backlight {
			compatible = "ti,lm3631-backlight";
			bl-name = "lcd";
			full-strings-used;
			mode-pwm-only;

			pwm-period = <10000>;

			pwms = <&pwm3943 1 10000>;
			pwm-names = "lm3631-backlight";
		};
};
```

## Documentation/devicetree/bindings/video/backlight/lm3632_bl.txt
```
TI LM3632 Backlight Driver

Required properties:
  - compatible: "ti,lm3632-backlight"

Optional properties:
  - bl-name: Backlight device name. /sys/class/backlight/##bl-name##.
  - full-strings-used: Define it in case of two LED strings used.

PWM specific optional properties:
  - pwm-period: PWM period value. Define it in case of PWM based control mode.
                If this property is not defined, then brightness control mode is I2C.
  - pwm-max-brightness: Max current value in register 0x04 and 0x05.
                        Range is from 0 to 2047.
  - pwms and pwm-names: Please refer to Documentation/devicetree/bindings/pwm/pwm.txt.

Example 1:
Brightness mode is I2C. Two backlight strings are used.
If 'bl-name' is not specified, then the lcd channel name is 'lcd-backlight'
by default. (/sys/class/backlight/lcd-backlight/)

lm3632@11 {
	compatible = "ti,lm3632";
	reg = <0x11>;

	ti,en-gpio = <&gpio0 3 0>;

	backlight {
		compatible = "ti,lm3632-backlight";
		full-strings-used;
	};
};

Example 2:
Backlight mode is PWM. Brightness is controlled by PWM controller, PWM3943.
PWM#0 is port number of PMW3943.
Channel name is 'lcd'. (/sys/class/backlight/lcd/)

lm3632@11 {
	compatible = "ti,lm3632";
	reg = <0x11>;

	ti,en-gpio = <&gpio0 3 0>;

	backlight {
		compatible = "ti,lm3632-backlight";

		bl-name = "lcd";
		full-strings-used;

		pwm-period = <10000>;
		pwm-max-brightness = <1637>; /* 20mA */

		/* PWM controller for lm3632 backlight */
		pwms = <&pwm3943 0 10000>;
		pwm-names = "lm3632-backlight";
	};
};
```
